## config/boards/shields/totem/Kconfig.defconfig
```kconfig
if SHIELD_TOTEM_LEFT

    config ZMK_KEYBOARD_NAME
        default "TOTEM"

    config ZMK_SPLIT_BLE_ROLE_CENTRAL
        default y

endif # LEFT



if SHIELD_TOTEM

    config ZMK_SPLIT
        default y

endif # LEFT RIGHT
```

## config/boards/shields/totem/Kconfig.shield
```kconfig
config SHIELD_TOTEM
    bool

config SHIELD_TOTEM_LEFT
    def_bool $(shields_list_contains,totem_left)
    select SHIELD_TOTEM

config SHIELD_TOTEM_RIGHT
    def_bool $(shields_list_contains,totem_right)
    select SHIELD_TOTEM
```

## config/west.yml
```yaml
manifest:
  remotes:
    - name: zmkfirmware
      url-base: https://github.com/zmkfirmware
    - name: cosmicbuffalo
      url-base: https://github.com/cosmicbuffalo
  projects:
    - name: zmk
      remote: cosmicbuffalo
      revision: adv360
      import: app/west.yml
  self:
    path: config
```
